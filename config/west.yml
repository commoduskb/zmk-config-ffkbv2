## config/west.yml
```yaml
manifest:
  remotes:
    - name: Nick-Munnich
      url-base: https://github.com/Nick-Munnich
    - name: sadekbaroudi
      url-base: https://github.com/sadekbaroudi
  projects:
    - name: zmk
      remote: Nick-Munnich
      revision: 6e4fd82791b53e59872c2c2428123aa8aa06523b
      import: app/west.yml
    - name: zmk-fingerpunch-keyboards
      remote: sadekbaroudi
      revision: main
      import: config/deps.yml
    - name: zmk-fingerpunch-vik
      remote: sadekbaroudi
      revision: main
      import: config/deps.yml
    - name: zmk-fingerpunch-controllers
      remote: sadekbaroudi
      revision: main
      import: config/deps.yml
  self:
    path: config
```
